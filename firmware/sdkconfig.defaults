## firmware/sdkconfig.defaults
```kconfig
# Sleep Tracker default config — ESP32-S3R8 (dual-core LX7, 8 MB octal PSRAM, 16 MB flash)
# Regenerate sdkconfig from these with: idf.py set-target esp32s3 && idf.py reconfigure

CONFIG_IDF_TARGET="esp32s3"

# --- Flash ---
CONFIG_ESPTOOLPY_FLASHSIZE_16MB=y
CONFIG_ESPTOOLPY_FLASHSIZE="16MB"
CONFIG_ESPTOOLPY_FLASHMODE_QIO=y

# --- Custom partition table (app + storage) ---
CONFIG_PARTITION_TABLE_CUSTOM=y
CONFIG_PARTITION_TABLE_CUSTOM_FILENAME="partitions.csv"

# --- PSRAM (S3R8 is OCTAL SPI RAM) — the reason we picked the S3 ---
CONFIG_SPIRAM=y
CONFIG_SPIRAM_MODE_OCT=y
CONFIG_SPIRAM_SPEED_80M=y
CONFIG_SPIRAM_FETCH_INSTRUCTIONS=y
CONFIG_SPIRAM_RODATA=y
# Let large buffers (frame buffer, raw sample rings) land in PSRAM automatically
CONFIG_SPIRAM_USE_MALLOC=y
CONFIG_SPIRAM_MALLOC_ALWAYSINTERNAL=16384

# --- CPU ---
CONFIG_ESP_DEFAULT_CPU_FREQ_MHZ_240=y

# --- Compiler ---
# Build at -Os (size). Also a deliberate workaround: GCC 14.2 (IDF 5.4) hits an
# internal-compiler-error (segfault in the IRA pass) compiling ESP-IDF's own
# esp_lcd/rgb/esp_lcd_panel_rgb.c at the default -Og. -Os avoids it, and smaller
# code is the right default for a battery wearable anyway.
CONFIG_COMPILER_OPTIMIZATION_SIZE=y

# --- Power management (light sleep between sensor windows — PLAN.md §2.3) ---
CONFIG_PM_ENABLE=y
CONFIG_FREERTOS_USE_TICKLESS_IDLE=y
# Keep the light-sleep enter/exit path in IRAM (faster, less wake overhead) and
# only sleep once the idle task has been idle a few ticks. The `power` component
# switches on automatic light sleep (esp_pm_configure) during TRACKING.
CONFIG_PM_SLP_IRAM_OPT=y
CONFIG_FREERTOS_IDLE_TIME_BEFORE_SLEEP=3

# --- FATFS: night-log filenames are RTC-stamped (>8.3), so enable long names ---
CONFIG_FATFS_LFN_HEAP=y
CONFIG_FATFS_MAX_LFN=255

# --- LVGL: the watch UI needs larger Montserrat sizes than the default 14 (big
# clock / score / HR hero), and the C-lib allocator instead of the fixed 64 KB
# builtin pool (the ~200-widget UI exhausts it mid-build -> lv_malloc NULL ->
# lv_obj_add_style hang). Choice/aggregate symbols: after editing this file, run
# `rm firmware/sdkconfig.esp32s3-amoled` so they take effect on the next build. ---
CONFIG_LV_FONT_MONTSERRAT_12=y
CONFIG_LV_FONT_MONTSERRAT_20=y
CONFIG_LV_FONT_MONTSERRAT_28=y
CONFIG_LV_FONT_MONTSERRAT_36=y
CONFIG_LV_FONT_MONTSERRAT_48=y
CONFIG_LV_USE_CLIB_MALLOC=y

# --- FreeRTOS ---
CONFIG_FREERTOS_HZ=1000

# --- Console over the S3 native USB-Serial/JTAG (the board's USB-C, COM6) ---
# so app logs / idf_monitor work over the single USB cable without a UART bridge.
CONFIG_ESP_CONSOLE_USB_SERIAL_JTAG=y

# --- Logging ---
CONFIG_LOG_DEFAULT_LEVEL_INFO=y
```
